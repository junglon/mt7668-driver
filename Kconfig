## Kconfig
```kconfig
# SPDX-License-Identifier: GPL-2.0-only
config MT7668
	tristate "MediaTek MT7668 SDIO WiFi support (proprietary fullmac)"
	depends on CFG80211
	depends on MMC
	select WIRELESS_EXT
	select WEXT_PRIV
	help
	  This option enables support for the MediaTek MT7668 802.11ac
	  WiFi/Bluetooth combo chip connected via SDIO, using the
	  MediaTek proprietary fullmac driver stack.

	  The WiFi firmware files (WIFI_RAM_CODE_MT7668.bin etc.) must be
	  present in /lib/firmware on the target system.  Bluetooth on the
	  same chip is handled by the in-kernel btmtksdio driver.

	  To compile this driver as a module, choose M here: the module
	  will be called wlan_mt76x8_sdio.
```
